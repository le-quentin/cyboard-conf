## config/west.yml
```yaml
manifest:
  remotes:
    - name: zmkfirmware
      url-base: https://github.com/zmkfirmware
    - name: Cyboard-DigitalTailor
      url-base: https://github.com/Cyboard-DigitalTailor
    # Additional modules containing boards/shields/custom code can be listed here as well
    # See https://docs.zephyrproject.org/3.2.0/develop/west/manifest.html#projects
  projects:
    - name: zmk
      remote: zmkfirmware
      revision: 6b44d33db2f4bad7d98e475e6f7968493b05af73
      import: app/west.yml
    - name: zmk-keyboards
      remote: Cyboard-DigitalTailor
      revision: b20908a
      import: config/west.yml
  self:
    path: config
```
